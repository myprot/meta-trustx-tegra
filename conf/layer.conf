## conf/layer.conf
```bitbake
BBPATH := "${BBPATH}:${LAYERDIR}"

BBFILES := "${BBFILES} ${LAYERDIR}/recipes-*/*/*.bb \
           ${LAYERDIR}/recipes-*/*/*.bbappend \
           ${LAYERDIR}/images/*.bb*"


BBFILE_COLLECTIONS += "trustx-tegra"
BBFILE_PATTERN_trustx-tegra := "^${LAYERDIR}/"
BBFILE_PRIORITY_trustx-tegra := "8"

LAYERSERIES_COMPAT_trustx-tegra = "dunfell"
```
